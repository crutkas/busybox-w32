## configs/arm64_vnext_bootstrap_defconfig
```kconfig
CONFIG_HAVE_DOT_CONFIG=y
# CONFIG_PLATFORM_POSIX is not set
CONFIG_PLATFORM_MINGW32=y
# CONFIG_DESKTOP is not set
CONFIG_LONG_OPTS=y
CONFIG_SHOW_USAGE=y
CONFIG_FEATURE_VERBOSE_USAGE=y
CONFIG_FEATURE_COMPRESS_USAGE=y
CONFIG_LFS=y
CONFIG_TIME64=y
CONFIG_BUSYBOX=y
CONFIG_FEATURE_INSTALLER=y
CONFIG_FEATURE_VERSION=y
CONFIG_FEATURE_PREFER_APPLETS=y
CONFIG_BUSYBOX_EXEC_PATH=""
CONFIG_GLOBBING=y
# CONFIG_FEATURE_RESOURCES is not set
CONFIG_FEATURE_UTF8_INPUT=y
# CONFIG_FEATURE_UTF8_OUTPUT is not set
CONFIG_TERMINAL_MODE=5
CONFIG_OVERRIDE_APPLETS=""
CONFIG_STATICS_IN_BSS=y
CONFIG_CROSS_COMPILER_PREFIX="aarch64-w64-mingw32-"
CONFIG_HOST_COMPILER="clang"
CONFIG_CROSS_COMPILER="clang"
CONFIG_SYSROOT=""
CONFIG_EXTRA_CFLAGS="-Wno-unused-command-line-argument -Wdate-time"
CONFIG_EXTRA_LDFLAGS="-Wl,--no-insert-timestamp"
CONFIG_EXTRA_LDLIBS=""
CONFIG_USE_PORTABLE_CODE=y
CONFIG_WERROR=y
CONFIG_NO_DEBUG_LIB=y
CONFIG_OPTIMIZE_FOR_SPEED=y
CONFIG_FEATURE_BUFFERS_USE_MALLOC=y
CONFIG_FEATURE_COPYBUF_KB=4
CONFIG_UNICODE_SUPPORT=y
CONFIG_FEATURE_CHECK_UNICODE_IN_ENV=y
CONFIG_SUBST_WCHAR=63
CONFIG_LAST_SUPPORTED_WCHAR=1114111
CONFIG_UNICODE_COMBINING_WCHARS=y
CONFIG_UNICODE_WIDE_WCHARS=y
CONFIG_TAR=y
CONFIG_FEATURE_TAR_LONG_OPTIONS=y
CONFIG_FEATURE_TAR_CREATE=y
# CONFIG_FEATURE_TAR_AUTODETECT is not set
CONFIG_BASENAME=y
CONFIG_CAT=y
CONFIG_CP=y
CONFIG_FEATURE_NON_POSIX_CP=y
CONFIG_CUT=y
CONFIG_DATE=y
CONFIG_DIRNAME=y
CONFIG_ECHO=y
CONFIG_ENV=y
CONFIG_EXPR=y
CONFIG_FALSE=y
CONFIG_HEAD=y
CONFIG_INSTALL=y
CONFIG_LN=y
CONFIG_MKDIR=y
CONFIG_MV=y
CONFIG_PRINTF=y
CONFIG_PWD=y
CONFIG_READLINK=y
CONFIG_RM=y
CONFIG_SLEEP=y
CONFIG_SORT=y
CONFIG_TAIL=y
CONFIG_FEATURE_FANCY_TAIL=y
CONFIG_TEE=y
CONFIG_TEST=y
# CONFIG_TEST1 is not set
# CONFIG_TEST2 is not set
CONFIG_TOUCH=y
CONFIG_TR=y
CONFIG_TRUE=y
CONFIG_UNAME=y
CONFIG_WHICH=y
CONFIG_AWK=y
CONFIG_CMP=y
CONFIG_PATCH=y
CONFIG_SED=y
CONFIG_FIND=y
CONFIG_GREP=y
CONFIG_XARGS=y
CONFIG_SH_IS_ASH=y
# CONFIG_SH_IS_HUSH is not set
# CONFIG_SH_IS_NONE is not set
# CONFIG_BASH_IS_ASH is not set
# CONFIG_BASH_IS_HUSH is not set
CONFIG_BASH_IS_NONE=y
CONFIG_SHELL_ASH=y
# CONFIG_ASH is not set
CONFIG_ASH_INTERNAL_GLOB=y
CONFIG_ASH_BASH_COMPAT=y
CONFIG_ASH_ALIAS=y
CONFIG_ASH_EXPAND_PRMT=y
CONFIG_ASH_ECHO=y
CONFIG_ASH_PRINTF=y
CONFIG_ASH_TEST=y
CONFIG_ASH_GETOPTS=y
CONFIG_ASH_CMDCMD=y
CONFIG_ASH_NOCONSOLE=y
CONFIG_FEATURE_SH_MATH=y
CONFIG_FEATURE_SH_MATH_64=y
CONFIG_FEATURE_SH_EXTRA_QUIET=y
CONFIG_FEATURE_SH_STANDALONE=y
CONFIG_FEATURE_SH_NOFORK=y
```
